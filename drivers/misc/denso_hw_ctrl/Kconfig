## drivers/misc/denso_hw_ctrl/Kconfig
```kconfig
comment "DENSO Hardware Control"

config DENSO_HW_CTRL
	tristate "DENSO proprietary hardware control for HONDA battery disconnect, nor parameters"
	depends on MTD
	default n
	help
	  A DENSO proprietary module. Say m when you want to support this tool.

config DENSO_HW_CTRL_USE_PDR
	bool "Find the OEM region using the PDR directory?"
	depends on DENSO_HW_CTRL
	default n
	help
	  Determine the location of the OEM region in the IFWI in NOR using the PDR
	  directory.  If n (the default), a pre-determined location is used.
```

## drivers/staging/most/aim-cdev/Kconfig
```kconfig
config AIM_CDEV
	tristate "V4L2 AIM (cdev interface)"

	---help---
	  Say Y here if you want to communicate via V4L2 devices using
	  the interface of cdev driver.

	  To compile this driver as a module, choose M here: the
	  module will be called aim_cdev.
```

## drivers/staging/most/aim-sound/Kconfig
```kconfig
config AIM_SOUND
	tristate "V4L2 AIM (sound interface)"

	---help---
	  Say Y here if you want to communicate via V4L2 devices using
	  the interface of sound driver.

	  To compile this driver as a module, choose M here: the
	  module will be called aim_sound.
```

## drivers/staging/most/aim-v4l2/Kconfig
```kconfig
config AIM_V4L2
	tristate "V4L2 AIM (V4L2 interface)"

	---help---
	  Say Y here if you want to communicate via V4L2 devices using
	  the interface of V4L2 driver.

	  To compile this driver as a module, choose M here: the
	  module will be called aim_V4L2.
```

## drivers/staging/most/hdm-usb/Kconfig
```kconfig
config HDM_USB
	tristate "HDM_USB"

	---help---
	  Say Y here if you want to communicate via V4L2 devices using
	  the interface of hdm usb.

	  To compile this driver as a module, choose M here: the
	  module will be called hdm-usb
```

## drivers/staging/most/mostcore/Kconfig
```kconfig
config MOSTCORE
	tristate "MOSTCORE"

	---help---
	  Say Y here if you want to communicate via V4L2 devices using
	  the interface of mostcore driver.

	  To compile this driver as a module, choose M here: the
	  module will be called mostcore.
```
